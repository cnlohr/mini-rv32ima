## packages/this_opensbi/platform/riscv_emufun/Kconfig
```kconfig
# SPDX-License-Identifier: BSD-2-Clause

config PLATFORM_RISCV_EMUFUN
	bool
	select FDT
	select SERIAL_UART8250
	default y
```

## this_opensbi/platform/riscv_emufun/Kconfig
```kconfig
# SPDX-License-Identifier: BSD-2-Clause

config PLATFORM_RISCV_EMUFUN
	bool
	select SERIAL_UART8250
	default y
```
